## configs/rockchip_rv1126b_ohd_defconfig
```kconfig
#include "base/base.config"
#include "chips/rv1126b_aarch64.config"
#include "fs/exfat.config"
#include "fs/ntfs.config"
#include "fs/vfat.config"
#include "multimedia/camera.config"
#include "multimedia/gst/audio.config"
#include "multimedia/gst/camera.config"
#include "multimedia/gst/rtsp.config"
#include "multimedia/gst/video.config"
#include "multimedia/mpp.config"
#include "tools/common.config"
# BR2_PACKAGE_GST1_PLUGINS_GOOD_PLUGIN_PULSE is reset to default
BR2_PACKAGE_LIBSNDFILE=y
BR2_PACKAGE_LIBTOOL=y
# BR2_PACKAGE_PULSEAUDIO is reset to default
BR2_PACKAGE_OPENSSH=y
BR2_PACKAGE_OPENSSH_CLIENT=y
BR2_PACKAGE_OPENSSH_SERVER=y
BR2_PACKAGE_OPENSSH_ENABLE_ROOT_LOGIN=y
BR2_PACKAGE_OPENSSH_KEY_UTILS=y
# BR2_PACKAGE_ROCKCHIP_TEST is not set
BR2_TARGET_ROOTFS_UBI=y
BR2_TARGET_ROOTFS_UBI_UBIFS=y
BR2_PACKAGE_STM32FLASH=y
BR2_PACKAGE_BASH=y
# BR2_PACKAGE_CAMERA_ENGINE_RKAIQ is not set
# BR2_PACKAGE_EUDEV_ENABLE_HWDB is not set
# BR2_PACKAGE_GDB is not set
# BR2_PACKAGE_LINUX_TOOLS_PERF is not set
# BR2_PACKAGE_RKSCRIPT is not set
# BR2_PACKAGE_RKTOOLKIT is not set
# BR2_PACKAGE_ROCKCHIP_MPP_TESTS is not set
# BR2_PACKAGE_ROCKCHIP_RGA is not set
# BR2_PACKAGE_FAAD2 is not set
# BR2_PACKAGE_FLUIDSYNTH is not set
# BR2_PACKAGE_FLUIDSYNTH_ALSA_LIB is not set
# BR2_PACKAGE_GST1_PLUGINS_GOOD_JPEG is not set
# BR2_PACKAGE_GST1_PLUGINS_GOOD_PNG is not set
# BR2_PACKAGE_GST1_PLUGINS_GOOD_PLUGIN_FLV is not set
# BR2_PACKAGE_GST1_PLUGINS_BAD_PLUGIN_JPEGFORMAT is not set
# BR2_PACKAGE_GST1_PLUGINS_BAD_PLUGIN_MIDI is not set
# BR2_PACKAGE_GST1_PLUGINS_BAD_PLUGIN_ONVIF is not set
# BR2_PACKAGE_GST1_PLUGINS_BAD_PLUGIN_FAAD is not set
# BR2_PACKAGE_GST1_PLUGINS_BAD_PLUGIN_FLUIDSYNTH is not set
# BR2_PACKAGE_GST1_PLUGINS_BAD_PLUGIN_HLS is not set
# BR2_PACKAGE_GST1_PLUGINS_BAD_PLUGIN_KMS is not set
# BR2_PACKAGE_GST1_PLUGINS_UGLY_PLUGIN_DVDLPCMDEC is not set
# BR2_PACKAGE_GST1_PLUGINS_UGLY_PLUGIN_DVDSUB is not set
# BR2_PACKAGE_GST1_PLUGINS_UGLY_PLUGIN_MPEG2DEC is not set
# BR2_PACKAGE_MJPEGTOOLS is not set
# BR2_PACKAGE_MPG123 is not set
# BR2_PACKAGE_PULSEAUDIO_HAS_ATOMIC is not set
# BR2_PACKAGE_STRACE is not set
# BR2_PACKAGE_NTFS_3G is not set
# BR2_PACKAGE_EVTEST is not set
# BR2_PACKAGE_PARTED is not set
# BR2_PACKAGE_USBMOUNT is not set
# BR2_PACKAGE_CA_CERTIFICATES is not set
# BR2_PACKAGE_SQLITE is not set
# BR2_PACKAGE_GDK_PIXBUF is not set
# BR2_PACKAGE_JPEG is not set
# BR2_PACKAGE_JPEG_TURBO is not set
# BR2_PACKAGE_LIBDRM_INSTALL_TESTS is not set
# BR2_PACKAGE_LIBPNG is not set
# BR2_PACKAGE_LIBOGG is not set
# BR2_PACKAGE_LIBIDN2 is not set
# BR2_PACKAGE_LIBPSL is not set
# BR2_PACKAGE_LIBSOUP3 is not set
# BR2_PACKAGE_NGHTTP2 is not set
# BR2_PACKAGE_RTMPDUMP is not set
# BR2_PACKAGE_LRZSZ is not set
# BR2_PACKAGE_URANDOM_SCRIPTS is not set
```

## package/OpenHD-SysUtils/Config.in
```kconfig
config BR2_PACKAGE_OPENHD_SYSUTILS
    bool "openhd-sysutils"
    help
      OpenHD-SysUtils package
```

## package/gst-perf/Config.in
```kconfig
config BR2_PACKAGE_GST_PERF
	bool "gst-perf"
	depends on BR2_PACKAGE_GSTREAMER1
	help
	  GStreamer element to measure framerate, bitrate and CPU usage.

	  https://github.com/RidgeRun/gst-perf
```

## package/slotcfg/Config.in
```kconfig
config BR2_PACKAGE_SLOTCFG
    bool "slotcfg"
    help
      Small utility to manage slotconfig A/B metadata records.
```

## package/x21b-led-helper/Config.in
```kconfig
config BR2_PACKAGE_X21B_LED_HELPER
    bool "x21b-led-helper"
    select BR2_PACKAGE_LIBGPIOD
    help
      Small utility to handle x21b led mcu communications
```
